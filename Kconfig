## Kconfig
```kconfig
mainmenu "Neuro Kernel Configuration"

source "plat/Kconfig.defconfig"

menu "ARCH Configuration"
source "arch/Kconfig"
endmenu

menu "SOC Configuration"
source "soc/Kconfig"
endmenu

menu "PLATFORM Configuration"
source "plat/Kconfig"
endmenu

menu "Build and Link Features"
config TOOLCHAIN_GCC
    bool "gcc"
    help
        gcc

config TOOLCHAIN_LLVM
    bool "llvm"
    help
        llvm
endmenu
```

## arch/Kconfig
```kconfig
source "$(ARCH_DIR)/$(ARCH)/Kconfig"

config ARCH 
    string "cpu arch"
    default "arm"
    help
        cpu arch

config KERNEL_BITS
    int "kernel bits"
    default 32
    help
        32/64

config HAVE_FPU
    bool "fpu"
    default n

config OPTIMISATION
    string "optimisation"
    default -O0
    help
        -O0,-O1, -O2,-O3,-Os

config OPTIMISATION_CLONE
    bool "optimisation clone"
    default n
    
config WHOLE_PROGRAM
    bool "whole program"
    default n

config DEBUG_BUILD
    bool "debug build"
    default y

config CROSS_PREFIX
    string "compiler prefix"
    help
        such as aarch64-linux-gnu-

config PADDR_BITS_TOP
    int "paddr max bits"
    default 40
    help
        40/44
```

## arch/arm/Kconfig
```kconfig
config ARCH_ARM
    bool "arm"
    default y

config ARMV
    string "armv number"
    default "armv7-a"
    help
        armv8-a, armv7ve, armv7-a

config FEAT
    string "special feat."
    help
        +crc

config KERNEL_ARCH
    string "arm arch"
    default "aarch32"
    help
        aarch32,aarch64,arm_hyp

config MAX_NUM_NODES
    int "smp core numbers"
    default 8
    help
        0-N
```

## plat/am335x/Kconfig
```kconfig
config PLATFORM
    string "platform number"
    default "am335x"
    help
        am335x

config BOARD
    string "board number"
    default "am335x-boneblack"
    help
        am335x-boneblack
```

## soc/cortex-a9/Kconfig
```kconfig
config CPU 
    string "cpu infrastructure"
    default "cortex-a9"
    help
        cpu infrastructure - such as cortex-a9
```
